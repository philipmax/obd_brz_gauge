/* Generated by tools/make_video.py selftest-data - do not edit. */
/* 360x360 test picture: 9x9 cells of 40 px, palette index per cell,
 * lines 352..359 an orange band (half MCU row for 4:2:0). Q75 baseline. */
#define MJ_ST_SIZE   360
#define MJ_ST_CELL   40
#define MJ_ST_CELLS  9
#define MJ_ST_BAND_Y 352
static const uint8_t k_st_band[3] = {255, 128, 0};
static const uint8_t k_st_palette[9][3] = {
    {0, 0, 0},
    {255, 255, 255},
    {220, 30, 30},
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    {128, 128, 128},
};
static const uint8_t k_st_cells[9][9] = {
    {0, 1, 2, 3, 4, 5, 6, 7, 8},
    {3, 4, 5, 6, 7, 8, 0, 1, 2},
    {6, 7, 8, 0, 1, 2, 3, 4, 5},
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    {6, 7, 8, 0, 1, 2, 3, 4, 5},
};
static const uint8_t k_st_jpeg_422[3559] = {
    0xff, 0xd8, 0xff, 0xe0, 0x00, 0x10, 0x4a, 0x46, 0x49, 0x46, 0x00, 0x01, 0x01, 0x00, 0x00, 0x01,
    0x00, 0x01, 0x00, 0x00, 0xff, 0xdb, 0x00, 0x43, 0x00, 0x08, 0x06, 0x06, 0x07, 0x06, 0x05, 0x08,
    0x07, 0x07, 0x07, 0x09, 0x09, 0x08, 0x0a, 0x0c, 0x14, 0x0d, 0x0c, 0x0b, 0x0b, 0x0c, 0x19, 0x12,
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    0x00, 0x00, 0x00, 0x00, 0x00, 0xff, 0xd9,
};
static const uint8_t k_st_jpeg_420[3526] = {
    0xff, 0xd8, 0xff, 0xe0, 0x00, 0x10, 0x4a, 0x46, 0x49, 0x46, 0x00, 0x01, 0x01, 0x00, 0x00, 0x01,
    0x00, 0x01, 0x00, 0x00, 0xff, 0xdb, 0x00, 0x43, 0x00, 0x08, 0x06, 0x06, 0x07, 0x06, 0x05, 0x08,
    0x07, 0x07, 0x07, 0x09, 0x09, 0x08, 0x0a, 0x0c, 0x14, 0x0d, 0x0c, 0x0b, 0x0b, 0x0c, 0x19, 0x12,
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    0x00, 0x00, 0x00, 0x7f, 0xff, 0xd9,
};
